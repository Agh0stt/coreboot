## src/mainboard/raisin/Kconfig
```kconfig
## SPDX-License-Identifier: GPL-2.0-only

source "src/mainboard/raisin/picasso/Kconfig"
```

## src/mainboard/raisin/Kconfig.name
```kconfig
## SPDX-License-Identifier: GPL-2.0-only

config BOARD_RAISIN_PICASSO
	bool "Picasso"
```

## src/mainboard/raisin/picasso/Kconfig
```kconfig
## SPDX-License-Identifier: GPL-2.0-only

config BOARD_RAISIN_PICASSO
	bool "Raisin Picasso"
	select SOC_AMD_PICASSO
	select BOARD_ROMSIZE_KB_8192
	select HAVE_ACPI_TABLES
	select HAVE_ACPI_RESUME
	select AMD_SOC_CONSOLE_UART
	select DRIVERS_UART_8250IO
	select BOOTSPLASH_IMAGE
	select GENERATE_SMBIOS_TABLES

if BOARD_RAISIN_PICASSO

config MAINBOARD_DIR
	default "raisin/picasso"

config MAINBOARD_PART_NUMBER
	default "Raisin Picasso"

config MAINBOARD_VENDOR
	default "Raisin"

config DEVICETREE
	default "devicetree.cb"

config BOOTSPLASH_FILE
	default "bootsplash.jpg"

config PAYLOAD_DEFAULT
	default PAYLOAD_TIANOCORE

config TIANOCORE_BOOT_MANAGER_ESCAPE
	default y

config TIANOCORE_CBMEM_CONSOLE
	default y

config VBOOT
	default n

config USE_OPTION_TABLE
	default n

endif # BOARD_RAISIN_PICASSO
```

## src/mainboard/raisin/picasso/defconfig
```kconfig
CONFIG_BOARD_RAISIN_PICASSO=y
CONFIG_VENDOR_RAISIN=y

# ROM size
CONFIG_BOARD_ROMSIZE_KB_8192=y

# Payload - full UEFI via TianoCore EDK2
CONFIG_PAYLOAD_TIANOCORE=y
CONFIG_TIANOCORE_BOOT_MANAGER_ESCAPE=y
CONFIG_TIANOCORE_CBMEM_CONSOLE=y

# Legacy support via SeaBIOS chainloaded
CONFIG_TIANOCORE_CSM=y

# Boot splash
CONFIG_BOOTSPLASH_IMAGE=y
CONFIG_BOOTSPLASH_FILE="bootsplash.jpg"

# Console - UART0 for debug
CONFIG_AMD_SOC_CONSOLE_UART=y
CONFIG_CONSOLE_SERIAL=y
CONFIG_TTYS0_BAUD=115200

# ACPI
CONFIG_HAVE_ACPI_TABLES=y
CONFIG_HAVE_ACPI_RESUME=y

# SMBIOS
CONFIG_GENERATE_SMBIOS_TABLES=y
CONFIG_SMBIOS_MANUFACTURER="Raisin"
CONFIG_SMBIOS_PRODUCT_NAME="Raisin Picasso"

# No vboot for now
CONFIG_VBOOT=n
```
